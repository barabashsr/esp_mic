## sdkconfig.defaults
```kconfig
# Flash size (WROVER-E has 4MB flash)
CONFIG_ESPTOOLPY_FLASHSIZE_4MB=y

# Partition table
CONFIG_PARTITION_TABLE_CUSTOM=y
CONFIG_PARTITION_TABLE_CUSTOM_FILENAME="partitions.csv"

# PSRAM (WROVER has 4MB PSRAM)
CONFIG_SPIRAM=y
CONFIG_SPIRAM_SPEED_40M=y

# HTTP Server - WebSocket support
CONFIG_HTTPD_WS_SUPPORT=y

# FAT filesystem - long filenames in heap
CONFIG_FATFS_LFN_HEAP=y
CONFIG_FATFS_MAX_LFN=63

# Increase main task stack for init
CONFIG_ESP_MAIN_TASK_STACK_SIZE=4096
```
